## config/west.yml
```yaml
manifest:
  remotes:
    - name: zmkfirmware
      url-base: https://github.com/zmkfirmware
    - name: kilipan
      url-base: https://github.com/kilipan
    - name: sadekbaroudi
      url-base: https://github.com/sadekbaroudi
    - name: hazels-garage
      url-base: https://github.com/hazels-garage
    - name: petejohanson
      url-base: https://github.com/petejohanson
    # Additional modules containing boards/shields/custom code can be listed here as well
    # See https://docs.zephyrproject.org/3.2.0/develop/west/manifest.html#projects
  projects:
    - name: zmk
      remote: zmkfirmware
      revision: v0.3
      import: app/west.yml
    - name: zmk-keyboards-zilpzalp
      remote: kilipan
      revision: main
    - name: zmk-fingerpunch-keyboards
      remote: sadekbaroudi
      revision: main
      import: config/deps.yml
    - name: zmk-bad-wings-2
      remote: hazels-garage
      revision: main
    - name: cirque-input-module
      remote: petejohanson
      revision: main
  self:
    path: config
```
